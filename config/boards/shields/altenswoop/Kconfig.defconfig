## config/boards/shields/altenswoop/Kconfig.defconfig
```kconfig
# Copyright (c) 2022 Duccio Breschi
# SPDX-License-Identifier: MIT

if SHIELD_ALTENSWOOP_LEFT

config ZMK_KEYBOARD_NAME
    default "altenswoop"

config ZMK_SPLIT_ROLE_CENTRAL
    default y

endif

if SHIELD_ALTENSWOOP_LEFT || SHIELD_ALTENSWOOP_RIGHT

config ZMK_SPLIT
    bool
    default y


if ZMK_DISPLAY

config I2C
    bool
    default y

config SSD1306
    bool
    default y

config SSD1306_REVERSE_MODE
    bool
    default y

endif # ZMK_DISPLAY

if LVGL

config LV_Z_VDB_SIZE
    int
    default 64

config LV_Z_DPI
    int
    default 148

config LV_Z_BITS_PER_PIXEL
    int
    default 1

choice LV_COLOR_DEPTH
    default LV_COLOR_DEPTH_1
endchoice

endif # LVGL

endif
```

## config/west.yml
```yaml
manifest:
  remotes:
    # zmk official
    - name: zmkfirmware
      url-base: https://github.com/zmkfirmware
    # testing mouse keys
    - name: mousekeys
      url-base: https://github.com/petejohanson
  projects:
    - name: zmk
      remote: mousekeys
      revision: feat/pointers-move-scroll
      import: app/west.yml
  self:
    path: config
```
